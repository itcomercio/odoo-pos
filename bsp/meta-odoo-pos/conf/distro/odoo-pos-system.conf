## bsp/meta-odoo-pos/conf/distro/odoo-pos-system.conf
```bitbake
# Distro personalizada para Odoo POS basada en poky.
# Fuerza systemd como init manager y mantiene empaquetado RPM.

require conf/distro/poky.conf

DISTRO = "odoo-pos-system"
DISTRO_NAME = "Odoo POS (by Comodoo Digital)"
DISTRO_VERSION ?= "1.0"

# Keep baseline x86-64 ISA for broad hardware compatibility.
DEFAULTTUNE = "x86-64"

INIT_MANAGER = "systemd"
VIRTUAL-RUNTIME_init_manager = "systemd"
VIRTUAL-RUNTIME_initscripts = ""

DISTRO_FEATURES:append = " systemd usrmerge pam"
DISTRO_FEATURES:remove = " sysvinit"
DISTRO_FEATURES_BACKFILL_CONSIDERED:append = " sysvinit"

PACKAGE_CLASSES ?= "package_rpm"
```

## bsp/meta-odoo-pos/conf/layer.conf
```bitbake
# We have a conf and classes directory, add to BBPATH
BBPATH .= ":${LAYERDIR}"

# We have recipes-* directories, add to BBFILES
BBFILES += "${LAYERDIR}/recipes-*/*/*.bb \
            ${LAYERDIR}/recipes-*/*/*.bbappend"

BBFILE_COLLECTIONS += "odoo-pos"
BBFILE_PATTERN_odoo-pos = "^${LAYERDIR}/"
BBFILE_PRIORITY_odoo-pos = "6"

LAYERDEPENDS_odoo-pos = "core"
LAYERSERIES_COMPAT_odoo-pos = "wrynose"
```
